## Small_5/package/ipk/luci-app-unblockmusic/Config.in
```kconfig
config UnblockNeteaseMusic_Go
	bool "UnblockNeteaseMusic Golang Version"
	default n

config UnblockNeteaseMusic_NodeJS
	bool "UnblockNeteaseMusic NodeJS Version"
	depends on HAS_FPU || KERNEL_MIPS_FPU_EMULATOR || SOFT_FLOAT
	default y
```
